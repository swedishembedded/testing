## west.yml
```yaml
# SPDX-License-Identifier: Apache-2.0

manifest:
  self:
    path: modules/test/testing

  remotes:
    - name: throwtheswitch
      url-base: https://github.com/ThrowTheSwitch
  projects:
    - name: cmock
      path: modules/test/cmock
      revision: v2.5.3
      remote: throwtheswitch
    - name: unity
      path: modules/test/cmock/vendor/unity
      revision: v2.5.2
      remote: throwtheswitch
```
